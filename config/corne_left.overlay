/* corne_left.overlay */

#include "corne.dtsi"

/* Point the shield at our kscan node */
 / {
    chosen {
        zmk,kscan = &kscan0;
    };
};

/* KSCAN pin map */
&kscan0 {
    /* You can keep this if you want to be explicit; the shield already sets it */
    diode-direction = "col2row";

    /* 4 rows */
    row-gpios = <
        &gpio0 10 (GPIO_ACTIVE_HIGH | GPIO_PULL_DOWN)
        &gpio0  9 (GPIO_ACTIVE_HIGH | GPIO_PULL_DOWN)
        &gpio0 24 (GPIO_ACTIVE_HIGH | GPIO_PULL_DOWN)
        &gpio1  0 (GPIO_ACTIVE_HIGH | GPIO_PULL_DOWN)
    >;

    /* columns */
    col-gpios = <
        &gpio0 31 GPIO_ACTIVE_HIGH
        &gpio0 29 GPIO_ACTIVE_HIGH
        &gpio0  2 GPIO_ACTIVE_HIGH
        &gpio1 15 GPIO_ACTIVE_HIGH
        &gpio1 13 GPIO_ACTIVE_HIGH
        &gpio1 11 GPIO_ACTIVE_HIGH
        &gpio0  6 GPIO_ACTIVE_HIGH
        &gpio0  8 GPIO_ACTIVE_HIGH
        &gpio0 17 GPIO_ACTIVE_HIGH
        &gpio0 20 GPIO_ACTIVE_HIGH
        &gpio0 22 GPIO_ACTIVE_HIGH
    >;
};
